## config/boards/shields/eighteen/Kconfig.shield
```kconfig
# Copyright (c) 2022 The ZMK Contributors
# SPDX-License-Identifier: MIT

config SHIELD_EIGHTEEN
    def_bool $(shields_list_contains,eighteen)
```
