/*
 * Copyright (c) 2020 The ZMK Contributors
 *
 * SPDX-License-Identifier: MIT
 */

#include <behaviors.dtsi>
#include <dt-bindings/zmk/keys.h>
#include <dt-bindings/zmk/bt.h>
#include "zmk-helpers/helper.h"

/* Layers */
#define AL1 0
#define AL2 1
#define SM 2
#define NUM 3
#define SYS 4
#define BT 5
#define FUN 6
#define AL2U 7
#define MOUSE 8

#include "combos.dtsi" // requires layer aliases
#include "mouse.dtsi"

#define XXX &none
#define ___ &trans

/* Settings */

#define QUICK_TAP_MS 175

&sk {  // sticky-key config
    release-after-ms = <900>;  // release after 0.6s
    quick-release;             // no double capitalization when rolling keys
};

&sl {  // sticky-layer config
    ignore-modifiers;          // allow chording sticky mods & layers
};

&lt {  // layer-tap config
    flavor = "balanced";
    tapping-term-ms = <200>;
    quick-tap-ms = <QUICK_TAP_MS>;
};

/* Homerow mods */

#define KEYS_L 0 1 2 6 7 8 9       // left hand
#define KEYS_R 3 4 5 10 11 12 13   // right hand
#define THUMBS 14 15 16 17         // thumbs

#define MAKE_HRM(NAME, HOLD, TAP, TRIGGER_POS) \
    ZMK_BEHAVIOR(NAME, hold_tap, \
        flavor = "balanced"; \
        tapping-term-ms = <280>; \
        quick-tap-ms = <QUICK_TAP_MS>; \
        require-prior-idle-ms = <150>; \
        bindings = <HOLD>, <TAP>; \
        hold-trigger-key-positions = <TRIGGER_POS>; \
        hold-trigger-on-release; \
    )
MAKE_HRM(hml, &kp, &kp, KEYS_R THUMBS)  // left-hand HRMs
MAKE_HRM(hmr, &kp, &kp, KEYS_L THUMBS)  // right-hand HRMs

/* Homerow layers */
#define MAKE_HRL(NAME, HOLD, TAP, TRIGGER_POS) \
    ZMK_BEHAVIOR(NAME, hold_tap, \
        flavor = "balanced"; \
        tapping-term-ms = <220>; \
        quick-tap-ms = <250>; \
        require-prior-idle-ms = <150>; \
        bindings = <HOLD>, <TAP>; \
        hold-trigger-key-positions = <TRIGGER_POS>; \
        hold-trigger-on-release; \
    )
MAKE_HRL(hll, &mo, &kp, KEYS_R THUMBS)  // left-hand HRMs
MAKE_HRL(hlr, &mo, &kp, KEYS_L THUMBS)  // right-hand HRMs

/* Sys layer navigation */

// long-tap action on hold, short-tap action on all interrupts
#define MT_CORE \
    flavor = "tap-preferred"; \
    tapping-term-ms = <220>; \
    quick-tap-ms = <220>; \
    hold-trigger-key-positions = <0>;

&mt { MT_CORE };
ZMK_HOLD_TAP(mt_home, bindings = <&masked_home>, <&kp>; MT_CORE)
ZMK_HOLD_TAP(mt_end, bindings = <&masked_end>, <&kp>; MT_CORE)

#define HYPR LC(RS(LA(LGUI)))
#define SYS_LEFT  &mt_home 0   LEFT    // tap: left  | long-tap: beginning of line
#define SYS_RIGHT &mt_end 0    RIGHT   // tap: right | long-tap: end       of line
#define SYS_UP    &mt LC(HOME) UP      // tap: up    | long-tap: beginning of document
#define SYS_DOWN  &mt LC(END)  DOWN    // tap: down  | long-tap: end       of document
#define SYS_BSPC  &mt LC(BSPC) BSPC    // tap: bspc  | long-tap: delete word backward
#define SYS_DEL   &mt LC(DEL)  DEL     // tap: del   | long-tap: delete word forward
#define SYS_UNDO &kp LG(Z)
#define SYS_REDO &kp LG(LS(Z))

// mask CTRL when holding left/right to avoid accidental jumps to beginning/end of document
#define MASK_MODS(NAME, MODS, BINDING) \
    ZMK_MOD_MORPH(NAME, \
        bindings = <BINDING>, <BINDING>; \
        mods = <MODS>; \
    )
MASK_MODS(masked_home, (MOD_LCTL), &kp HOME)
MASK_MODS(masked_end,  (MOD_LCTL), &kp END)

#define PRTSC LG(LS(N5))

#define PREV_TAB  &mt LG(LBKT) LG(LS(LBKT))    // tap: prev_tab  | long-tap: backward
#define NEXT_TAB   &mt LG(RBKT)  LG(LS(RBKT))     // tap: next_tab   | long-tap: forward

/* Caps-word */

// tap: sticky-shift | shift + tap/ double-tap: caps-word | hold: shift
ZMK_MOD_MORPH(smart_shft,
    bindings = <&sk LSHFT>, <&caps_word>;
    mods = <(MOD_LSFT)>;
)
&caps_word {  // mods deactivate caps-word, requires PR #1451
    /delete-property/ ignore-modifiers;
};

// smart-mouse, requires PR #1366
ZMK_TRI_STATE(smart_mouse,
    bindings = <&tog MOUSE>, <&none>, <&tog MOUSE>;
    ignored-key-positions = <0 2 3 4 5 6 10 11 12 13 16 17>;
    ignored-layers = <MOUSE>;
)

// CMD+Tab swapper, requires PR #1366
ZMK_TRI_STATE(swapper,
    bindings = <&kt LGUI>, <&kp TAB>, <&kt LGUI>;
    ignored-key-positions = <0 15>;
)

// reuse basic mod-morph scheme
#define SIMPLE_MORPH(NAME, MOD, BINDING1, BINDING2) \
    ZMK_MOD_MORPH(NAME, \
        mods = <(MOD_L ## MOD|MOD_R ## MOD)>; \
        bindings = <BINDING1>, <BINDING2>; \
    )

// tap: comma | shift + tap: semicolon | ctrl + shift + tap: <
SIMPLE_MORPH(comma_morph, SFT, &kp COMMA, &comma_inner_morph)
SIMPLE_MORPH(comma_inner_morph, CTL, &kp SEMICOLON, &kp LESS_THAN)

// tap: dot | shift + tap: colon | ctrl + shift + tap: >
SIMPLE_MORPH(dot_morph, SFT, &kp DOT, &dot_inner_morph)
SIMPLE_MORPH(dot_inner_morph, CTL, &kp COLON, &kp GREATER_THAN)

// tap: copy | double-tap: cut | hold: paste
ZMK_TAP_DANCE(ccp,
    tapping-term-ms = <200>;
    bindings = <&mt LG(V) LG(C)>, <&kp LG(X)>;
)
// tap: vol_up | shift + tap: vol_dn
SIMPLE_MORPH(vol_morph, SFT, &kp C_VOL_UP, &kp C_VOL_DN)
// tap: bri_up | shift + tap: bri_down
SIMPLE_MORPH(bri_morph, SFT, &kp C_BRI_UP, &kp C_BRI_DN)
// tap: next | shift + tap: prev
SIMPLE_MORPH(prev_next_morph, SFT, &kp C_PREV, &kp C_NEXT)

// tap: bspc | shift + tap del
SIMPLE_MORPH(bspc_morph, SFT, SYS_BSPC, SYS_DEL)

// tap: 1/2/3 | shift + tap 7/8/9
SIMPLE_MORPH(n1_morph, SFT, &kp N1, &kp N7)
SIMPLE_MORPH(n2_morph, SFT, &kp N2, &kp N8)
SIMPLE_MORPH(n3_morph, SFT, &kp N3, &kp N9)

/* Vim macro */
// toggle between two most recent buffers
ZMK_BEHAVIOR(tog_buf, macro,
    wait-ms = <100>;
    tap-ms = <5>;
    bindings = <&kp LC(N6)>;
)

//paste from 0 registry below
ZMK_BEHAVIOR(rpb, macro,
    bindings = <&kp DQT &kp N0 &kp P>;
)
//paste from 0 registry above
ZMK_BEHAVIOR(rpa, macro,
    bindings = <&kp DQT &kp N0 &kp LS(P)>;
)

/ { 
    behaviors {
        sr: shift_layer {
            compatible = "zmk,behavior-hold-tap";
            label = "SHIFT_LAYER";
            #binding-cells = <2>;
            tapping-term-ms = <300>;
            quick_tap_ms = <0>;
            flavor = "balanced";
            bindings = <&kp>, <&to>;

             quick_tap_ms = <175>;
            // retro-tap;
        };
   	alpha2macro: behavior_macro_1 {
			compatible = "zmk,behavior-macro";
			label = "MACRO1";
			#binding-cells = <0>;
			bindings = < &sl AL2 >;
		};
	caps_alpha2macro: behavior_macro_2 {
			compatible = "zmk,behavior-macro";
			label = "MACRO2";
			#binding-cells = <0>;
			bindings = < &sl AL2U >;
		};
  };
};
  
//                  0       1       2                   3       4           5
//          6       7       8       9                   10      11          12          13
//                          14      15                  16      17

ZMK_LAYER(base,
//              ╭─────────────┬─────────────┬─────────────╮ ╭─────────────┬─────────────┬─────────────╮
                  &hml LGUI L   &hml LALT G   &hml LCTL D     &hmr RCTL H   &hmr RALT U   &hmr RGUI C
//╭─────────────┼─────────────┼─────────────┼─────────────┤ ├─────────────┼─────────────┼─────────────┼─────────────╮
    &hll NUM A    &hll SM R     &hll FUN S    &hll SYS T      &hlr SYS N    &hlr FUN E    &hlr SM I     &hlr NUM O
//╰─────────────┴─────────────┼─────────────┼─────────────┤ ├─────────────┼─────────────┼─────────────┴─────────────╯
                                &mt HYPR SPC &smart_shft      &bspc_morph   &sl AL2  
//                            ╰─────────────┴─────────────╯ ╰─────────────┴─────────────╯                                          
)

ZMK_LAYER(al2,
//              ╭─────────────┬─────────────┬─────────────╮ ╭─────────────┬─────────────┬─────────────╮
                  &kp V         &kp W         &kp P           &kp M         &kp J         &kp F 
//╭─────────────┼─────────────┼─────────────┼─────────────┤ ├─────────────┼─────────────┼─────────────┼─────────────╮
    &kp Q         &kp Z         &kp X         &kp B           &kp K         &rpb          &kp Y         &tog_buf
//╰─────────────┴─────────────┼─────────────┼─────────────┤ ├─────────────┼─────────────┼─────────────┴─────────────╯
                                &kp SPC       &sr LSHIFT AL1  ___           &sl AL2U     
//                            ╰─────────────┴─────────────╯ ╰─────────────┴─────────────╯                                          
)

ZMK_LAYER(sym,
//              ╭─────────────┬─────────────┬─────────────╮ ╭─────────────┬─────────────┬─────────────╮
                  &kp AT        &kp HASH      &kp AMPS        &kp LPAR      &kp RPAR      &kp LBRC
//╭─────────────┼─────────────┼─────────────┼─────────────┤ ├─────────────┼─────────────┼─────────────┼─────────────╮
    &kp EXCL	  &kp CARET	    &kp PRCNT     &kp DLLR        &kp LBKT      &kp RBKT      &kp RBRC      &kp QMARK
//╰─────────────┴─────────────┼─────────────┼─────────────┤ ├─────────────┼─────────────┼─────────────┴─────────────╯
                                &kp LCTL      &sr LSHIFT AL1  &kp LALT      &kp RGUI        
//                            ╰─────────────┴─────────────╯ ╰─────────────┴─────────────╯                                          
)

ZMK_LAYER(num,
//              ╭─────────────┬─────────────┬─────────────╮ ╭─────────────┬─────────────┬─────────────╮
                  &hml LCTL UNDER &hml LALT MINUS  &hml LGUI PLUS    &hmr RGUI N4  &hmr RALT N5  &hmr RCTL N6
//╭─────────────┼─────────────┼─────────────┼─────────────┤ ├─────────────┼─────────────┼─────────────┼─────────────╮
    &kp EQUAL     &kp BSLH     &kp FSLH       &kp STAR        &n1_morph		&n2_morph  	  &n3_morph		&kp N0
//╰─────────────┴─────────────┼─────────────┼─────────────┤ ├─────────────┼─────────────┼─────────────┴─────────────╯
                                &kp LCTL      &sr LSHIFT AL1  &kp LALT      &kp RGUI        
//                            ╰─────────────┴─────────────╯ ╰─────────────┴─────────────╯                                          
)

ZMK_LAYER(sys,
//              ╭─────────────┬─────────────┬─────────────╮ ╭─────────────┬─────────────┬─────────────╮
                  &kp ESC       SYS_UNDO      SYS_REDO        PREV_TAB      SYS_UP        NEXT_TAB
//╭─────────────┼─────────────┼─────────────┼─────────────┤ ├─────────────┼─────────────┼─────────────┼─────────────╮
    &kp TAB       &ccp          &swapper      &kp LG(GRAVE)   SYS_LEFT      SYS_DOWN      SYS_RIGHT     &kp RET
//╰─────────────┴─────────────┼─────────────┼─────────────┤ ├─────────────┼─────────────┼─────────────┴─────────────╯
                                &kp LCTL      &sr LSHIFT AL1  &kp LALT      &kp RGUI           
//                            ╰─────────────┴─────────────╯ ╰─────────────┴─────────────╯                                          
)

ZMK_LAYER(bt,
//              ╭─────────────┬─────────────┬─────────────╮ ╭─────────────┬─────────────┬─────────────╮
                  &bt BT_SEL 0  &bt BT_SEL 1  &bt BT_SEL 2    &bt BT_SEL 3  &bt BT_SEL 4  ___
//╭─────────────┼─────────────┼─────────────┼─────────────┤ ├─────────────┼─────────────┼─────────────┼─────────────╮
    &bt BT_CLR    &sys_reset    ___           &bootloader     &bootloader   ___           &sys_reset    &bt BT_CLR
//╰─────────────┴─────────────┼─────────────┼─────────────┤ ├─────────────┼─────────────┼─────────────┴─────────────╯
                                ___           &to AL1         ___    ___
//                            ╰─────────────┴─────────────╯ ╰─────────────┴─────────────╯                                          
)

ZMK_LAYER(fun,
//              ╭─────────────┬─────────────┬─────────────╮ ╭─────────────┬─────────────┬─────────────╮
                  &kp F11       &kp F10       &kp F1          &kp F2        &kp F3        &kp F4
//╭─────────────┼─────────────┼─────────────┼─────────────┤ ├─────────────┼─────────────┼─────────────┼─────────────╮
    &vol_morph    &kp F12       &mt PRTSC F5  &kp F6          &kp F7        &kp F8        &kp F9        &bri_morph
//╰─────────────┴─────────────┼─────────────┼─────────────┤ ├─────────────┼─────────────┼─────────────┴─────────────╯
                                &kp C_PP      &kp LSHIFT      &kp C_MUTE    &prev_next_morph    
//                            ╰─────────────┴─────────────╯ ╰─────────────┴─────────────╯                                          
)

ZMK_LAYER(al2u,
//              ╭─────────────┬─────────────┬─────────────╮ ╭─────────────┬─────────────┬─────────────╮
                  &kp LS(V)	    &kp LS(W)     &kp LS(P)       &kp LS(M)    	&kp LS(J) 	  &kp LS(F)	
//╭─────────────┼─────────────┼─────────────┼─────────────┤ ├─────────────┼─────────────┼─────────────┼─────────────╮
    &kp LS(Q) 	  &kp LS(Z)     &kp LS(X) 	  &kp LS(B)	      &kp LS(K)	     &rpa	      &kp LS(Y)	    ___
//╰─────────────┴─────────────┼─────────────┼─────────────┤ ├─────────────┼─────────────┼─────────────┴─────────────╯
                                ___ 	      ___ 		      ___      	    ___
//                            ╰─────────────┴─────────────╯ ╰─────────────┴─────────────╯                                          
)

ZMK_LAYER(mouse,
//              ╭─────────────┬─────────────┬─────────────╮ ╭─────────────┬─────────────┬─────────────╮
                  ___           ___           ___             U_WH_U        U_MS_U        U_WH_D
//╭─────────────┼─────────────┼─────────────┼─────────────┤ ├─────────────┼─────────────┼─────────────┼─────────────╮
    U_WH_R        ___           ___           ___             U_MS_L        U_MS_D        U_MS_R        U_WH_L
//╰─────────────┴─────────────┼─────────────┼─────────────┤ ├─────────────┼─────────────┼─────────────┴─────────────╯
                                ___           ___             &mkp LCLK     &mkp RCLK
//                            ╰─────────────┴─────────────╯ ╰─────────────┴─────────────╯                                          
)